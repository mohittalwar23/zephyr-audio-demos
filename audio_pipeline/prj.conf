## CMakeLists.txt
```
cmake_minimum_required(VERSION 3.20.0)

# ---------------------------------------------------------------------------
# Pipeline variant — must be set BEFORE find_package so EXTRA_CONF_FILE works
#
#   west build . -- -DPIPELINE=loopback
#   west build .                          (ml is default)
# ---------------------------------------------------------------------------
if(NOT DEFINED PIPELINE)
    set(PIPELINE "ml")
endif()
message(STATUS "audio_pipeline: PIPELINE=${PIPELINE}")

if(PIPELINE STREQUAL "loopback")
    set(EXTRA_CONF_FILE ${CMAKE_CURRENT_SOURCE_DIR}/prj_loopback.conf)
else()
    set(EXTRA_CONF_FILE ${CMAKE_CURRENT_SOURCE_DIR}/prj_ml.conf)
endif()

find_package(Zephyr REQUIRED HINTS $ENV{ZEPHYR_BASE})

project(audio_pipeline
    VERSION 0.1.0
    LANGUAGES C CXX
)

# ---------------------------------------------------------------------------
# ESP32 C++ ABI fix (ML only)
# ---------------------------------------------------------------------------
if(PIPELINE STREQUAL "ml")
    set(NO_THREADSAFE_STATICS $<TARGET_PROPERTY:compiler-cpp,no_threadsafe_statics>)
    zephyr_compile_options($<$<COMPILE_LANGUAGE:CXX>:${NO_THREADSAFE_STATICS}>)
endif()

# ---------------------------------------------------------------------------
# Include paths — single root, subdirs accessed as core/ backends/ ml/
# ---------------------------------------------------------------------------
target_include_directories(app PRIVATE
    ${CMAKE_CURRENT_SOURCE_DIR}/include
)

# ---------------------------------------------------------------------------
# Core sources — always compiled
# ---------------------------------------------------------------------------
target_sources(app PRIVATE
    src/core/pcm_delay_node.c
    src/core/pcm_convert.c
)

# ---------------------------------------------------------------------------
# Backend sources — always compiled (both pipelines use I2S)
# ---------------------------------------------------------------------------
target_sources(app PRIVATE
    src/backends/i2s_source.c
    src/backends/i2s_sink.c
)

# ---------------------------------------------------------------------------
# Variant-specific sources
# ---------------------------------------------------------------------------
if(PIPELINE STREQUAL "loopback")
    target_sources(app PRIVATE src/main.c)

else()
    # ML pipeline
    if(MICRO_SPEECH_FLOAT_PREPROCESSOR)
        message(STATUS "audio_pipeline: preprocessor = float32")
        zephyr_compile_definitions(MICRO_SPEECH_FLOAT_PREPROCESSOR=1)
        set(PREPROCESSOR_SRC src/ml/audio_preprocessor_float_model.cpp)
    else()
        message(STATUS "audio_pipeline: preprocessor = INT8 quantized (default)")
        set(PREPROCESSOR_SRC src/ml/audio_preprocessor_int8_model.cpp)
    endif()

    set(TFLM_SIGNAL_DIR ${ZEPHYR_TFLITE_MICRO_MODULE_DIR}/signal)

    target_include_directories(app PRIVATE
        ${ZEPHYR_TFLITE_MICRO_MODULE_DIR}/signal
        ${ZEPHYR_TFLITE_MICRO_MODULE_DIR}/signal/micro/kernels
        ${ZEPHYR_TFLITE_MICRO_MODULE_DIR}/signal/src
    )

    target_sources(app PRIVATE
        src/main_ml.c
        src/ml/pcm_ml_node.c
        src/ml/model_runner.cpp
        src/ml/micro_speech_quantized_model.cpp
        ${PREPROCESSOR_SRC}
        # TFLite signal processing sources
        ${TFLM_SIGNAL_DIR}/src/fft_auto_scale.cc
        ${TFLM_SIGNAL_DIR}/src/max_abs.cc
        ${TFLM_SIGNAL_DIR}/src/msb_32.cc
        ${TFLM_SIGNAL_DIR}/src/energy.cc
        ${TFLM_SIGNAL_DIR}/src/filter_bank.cc
        ${TFLM_SIGNAL_DIR}/src/filter_bank_square_root.cc
        ${TFLM_SIGNAL_DIR}/src/square_root_64.cc
        ${TFLM_SIGNAL_DIR}/src/square_root_32.cc
        ${TFLM_SIGNAL_DIR}/src/msb_64.cc
        ${TFLM_SIGNAL_DIR}/src/pcan_argc_fixed.cc
        ${TFLM_SIGNAL_DIR}/src/filter_bank_log.cc
        ${TFLM_SIGNAL_DIR}/src/log.cc
        ${TFLM_SIGNAL_DIR}/src/filter_bank_spectral_subtraction.cc
        ${TFLM_SIGNAL_DIR}/micro/kernels/energy.cc
        ${TFLM_SIGNAL_DIR}/micro/kernels/fft_auto_scale_common.cc
        ${TFLM_SIGNAL_DIR}/micro/kernels/fft_auto_scale_kernel.cc
        ${TFLM_SIGNAL_DIR}/micro/kernels/filter_bank_square_root_common.cc
        ${TFLM_SIGNAL_DIR}/micro/kernels/filter_bank_square_root.cc
        ${TFLM_SIGNAL_DIR}/micro/kernels/filter_bank_spectral_subtraction.cc
        ${TFLM_SIGNAL_DIR}/micro/kernels/filter_bank.cc
        ${TFLM_SIGNAL_DIR}/micro/kernels/pcan.cc
        ${TFLM_SIGNAL_DIR}/micro/kernels/filter_bank_log.cc
    )
endif()
```

## prj.conf
```kconfig
# Common to all pipelines
CONFIG_I2S=y
CONFIG_LOG=y
CONFIG_LOG_DEFAULT_LEVEL=3
CONFIG_FPU=y
CONFIG_PRINTK=y
CONFIG_CONSOLE=y
CONFIG_UART_CONSOLE=y
CONFIG_MAIN_STACK_SIZE=4096
CONFIG_TIMEOUT_64BIT=y
CONFIG_NEWLIB_LIBC=y
```

## prj_loopback.conf
```kconfig
# Loopback-specific overrides
# No TFLM, no C++ — heap can be larger for delay node

# 250 blocks × ~284 bytes = ~71KB + headroom
CONFIG_HEAP_MEM_POOL_SIZE=98304

# No C++ needed
CONFIG_CPP=n
```

## prj_ml.conf
```kconfig
# ML-specific overrides
# TFLM arenas eat RAM so heap must stay small

# 50 delay blocks × ~284 bytes = ~14KB + TFLM arenas ~28KB + headroom
CONFIG_HEAP_MEM_POOL_SIZE=49152

# C++ required for model_runner.cpp
CONFIG_CPP=y
CONFIG_STD_CPP17=y
CONFIG_REQUIRES_FULL_LIBCPP=y
CONFIG_TENSORFLOW_LITE_MICRO=y

CONFIG_DYNAMIC_THREAD=y
CONFIG_DYNAMIC_THREAD_POOL_SIZE=2
```

## src/main.c
```c
/*
 * main.c  –  I2S delay loopback using the PCM pipeline abstraction
 *
 * Pipeline:
 *
 *   [INMP441 mic]
 *       │  I2S RX
 *   i2s_source_t
 *       │ pcm_block_t (S16_LE, 2ch*, 64 frames)
 *   pcm_convert: mono→stereo + gain       ← separate reusable stage
 *       │ pcm_block_t (S16_LE, 2ch, 64 frames)
 *   pcm_delay_node_t  (DELAY_BLOCKS deep) ← pipeline node, not app logic
 *       │ pcm_block_t (delayed)
 *   i2s_sink_t
 *       │  I2S TX
 *   [MAX98357A speaker]
 *
 * * The INMP441 is clocked as 2-channel but only fills the LEFT channel;
 *   the conversion stage handles the mono→stereo expansion with gain.
 *
 */

#include <zephyr/kernel.h>
#include <zephyr/device.h>
#include <zephyr/logging/log.h>

#include "backends/i2s_source.h"
#include "backends/i2s_sink.h"
#include "core/pcm_delay_node.h"
#include "core/pcm_convert.h"

LOG_MODULE_REGISTER(loopback, LOG_LEVEL_INF);

#define SAMPLE_RATE    16000
#define NUM_CHANNELS   2
#define FRAMES         64
#define BLOCK_SIZE     (FRAMES * NUM_CHANNELS * sizeof(int16_t))  /* 256 bytes */
#define SLAB_COUNT     6
#define DELAY_BLOCKS   250

#define AUDIO_GAIN     4    /* 1=unity, 8=very loud — tune to taste */


K_MEM_SLAB_DEFINE(rx_slab, BLOCK_SIZE, SLAB_COUNT, 4);
K_MEM_SLAB_DEFINE(tx_slab, BLOCK_SIZE, SLAB_COUNT, 4);

static i2s_source_t    rx_source;
static i2s_sink_t      tx_sink;
static pcm_delay_node_t delay_node;

#define LOG_INTERVAL 500

static void log_stats(uint32_t block_count)
{
    if (block_count % LOG_INTERVAL != 0) return;

    const pcm_stats_t *src  = &rx_source.base.stats;
    const pcm_stats_t *snk  = &tx_sink.base.stats;
    const pcm_stats_t *dly  = pcm_delay_node_stats(&delay_node);

    LOG_INF("--- pipeline stats (block %u) ---", block_count);
    LOG_INF("  source : ok=%u  overruns=%u  restarts=%u",
            src->blocks_ok, src->overruns, src->restarts);
    LOG_INF("  delay  : ok=%u  depth=%u  dropped=%u  underruns=%u",
            dly->blocks_ok, dly->queue_depth, dly->dropped, dly->underruns);
    LOG_INF("  sink   : ok=%u  overruns=%u  dropped=%u  restarts=%u",
            snk->blocks_ok, snk->overruns, snk->dropped, snk->restarts);
}


int main(void)
{
    int err;

    /* ── 1. Stream format ────────────────────────────────────────── */
    pcm_stream_info_t fmt = {
        .sample_rate = SAMPLE_RATE,
        .channels    = NUM_CHANNELS,
        .format      = PCM_FMT_S16_LE,
        .frames      = FRAMES,
    };

    /* ── 2. Init source ──────────────────────────────────────────── */
    i2s_source_cfg_t src_cfg = {
        .dev               = DEVICE_DT_GET(DT_ALIAS(i2s_rx)),
        .slab              = &rx_slab,
        .stream            = fmt,
        .driver_timeout_ms = 1000,
    };
    err = i2s_source_init(&rx_source, &src_cfg);
    if (err < 0) { LOG_ERR("source init: %d", err); return err; }

    /* ── 3. Init sink ────────────────────────────────────────────── */
    i2s_sink_cfg_t snk_cfg = {
        .dev               = DEVICE_DT_GET(DT_ALIAS(i2s_tx)),
        .slab              = &tx_slab,
        .stream            = fmt,
        .driver_timeout_ms = 2000,
        .prefill_blocks    = 3,
    };
    err = i2s_sink_init(&tx_sink, &snk_cfg);
    if (err < 0) { LOG_ERR("sink init: %d", err); return err; }

    /* ── 4. Init delay node ──────────────────────────────────────── */
    pcm_delay_node_cfg_t dly_cfg = {
        .delay_blocks = DELAY_BLOCKS,
        .max_blocks   = 0,  /* auto: delay + 10 */
    };
    err = pcm_delay_node_init(&delay_node, &dly_cfg);
    if (err < 0) { LOG_ERR("delay init: %d", err); return err; }

    /* ── 5. Start source ─────────────────────────────────────────── */
    err = pcm_source_start((pcm_source_t *)&rx_source);
    if (err < 0) { LOG_ERR("source start: %d", err); return err; }

    LOG_INF("pipeline ready — accumulating %u-block delay (~%u ms)…",
            DELAY_BLOCKS,
            (DELAY_BLOCKS * FRAMES * 1000U) / SAMPLE_RATE);

    /* ── 6. Pipeline loop ────────────────────────────────────────── */
    bool     tx_started  = false;
    uint32_t block_count = 0;

    while (1) {
        /* --- A. Read one block from the mic source ----------------- */
        pcm_block_t raw = {0};
        err = pcm_source_read((pcm_source_t *)&rx_source, &raw, K_FOREVER);
        if (err < 0) {
            LOG_WRN("source read err %d — retrying", err);
            continue;
        }

        /* --- B. Convert: INMP441 mono-left → stereo + gain -------- */
        pcm_block_t stereo = {0};
        err = pcm_mono_to_stereo_s16(&raw, &stereo, AUDIO_GAIN);
       
        pcm_source_release((pcm_source_t *)&rx_source, &raw);

        if (err < 0) {
            LOG_WRN("convert err %d — dropping block", err);
            continue;
        }

        /* --- C. Push converted block into the delay FIFO ---------- */
        err = pcm_delay_node_push(&delay_node, &stereo);
        if (err < 0) {
            /* push failed; stereo.data still ours — free it */
            k_free(stereo.data);
            LOG_WRN("delay push err %d", err);
            continue;
        }

        /* --- D. Start TX once the delay buffer is primed ---------- */
        if (!tx_started && pcm_delay_node_is_primed(&delay_node)) {
            err = pcm_sink_start((pcm_sink_t *)&tx_sink);
            if (err < 0) {
                LOG_ERR("sink start: %d", err);
                return err;
            }
            tx_started = true;
            LOG_INF("TX started — delay buffer full");
        }

        /* --- E. Pop one delayed block and play it ----------------- */
        if (tx_started) {
            pcm_block_t delayed = {0};
            err = pcm_delay_node_pop(&delay_node, &delayed);

            if (err == -EAGAIN) {
                /* Not primed yet — shouldn't happen post-start, but safe */
            } else if (err == -ENODATA) {
                /*
                 * Underrun: delay node ran dry.
                 * Restart the sink to avoid a TX stall.
                 */
                LOG_WRN("delay underrun — restarting sink");
                pcm_sink_drain((pcm_sink_t *)&tx_sink);
                pcm_sink_start((pcm_sink_t *)&tx_sink);
                tx_started = false;
            } else if (err == 0) {
                /*
                 * pcm_sink_write() takes ownership of delayed.data.
                 * On error, delayed.data is still ours — free it.
                 */
                err = pcm_sink_write((pcm_sink_t *)&tx_sink,
                                     &delayed, K_MSEC(500));
                if (err < 0) {
                    k_free(delayed.data);
                    LOG_WRN("sink write err %d", err);
                }
            }
        }

        /* --- F. Periodic stats ------------------------------------ */
        log_stats(++block_count);
    }

    /* Never reached in normal operation */
    pcm_source_stop((pcm_source_t *)&rx_source);
    pcm_sink_drain((pcm_sink_t *)&tx_sink);
    pcm_delay_node_flush(&delay_node);
    return 0;
}
```

## src/main_ml.c
```c
/*
 * main_ml.c  –  I2S mic → ML keyword tap → delay → I2S sink
 */

#include <zephyr/kernel.h>
#include <zephyr/device.h>
#include <zephyr/logging/log.h>

#include "backends/i2s_source.h"
#include "backends/i2s_sink.h"
#include "core/pcm_delay_node.h"
#include "core/pcm_convert.h"
#include "ml/pcm_ml_node.h"

LOG_MODULE_REGISTER(loopback_ml, LOG_LEVEL_INF);

#define SAMPLE_RATE    16000
#define NUM_CHANNELS   2
#define FRAMES         64
#define BLOCK_SIZE     (FRAMES * NUM_CHANNELS * sizeof(int16_t))
#define SLAB_COUNT     6
#define DELAY_BLOCKS   50      /* 50 × 4ms = 200ms — keeps heap small */
#define AUDIO_GAIN     4
#define LOG_INTERVAL   500

K_MEM_SLAB_DEFINE(rx_slab, BLOCK_SIZE, SLAB_COUNT, 4);
K_MEM_SLAB_DEFINE(tx_slab, BLOCK_SIZE, SLAB_COUNT, 4);

/* Static inference thread stack — avoids libc heap allocation */
PCM_ML_NODE_STACK_DEFINE(ml_infer_stack);

static i2s_source_t     rx_source;
static i2s_sink_t       tx_sink;
static pcm_delay_node_t delay_node;
static pcm_ml_node_t    ml_node;

static void on_ml_result(const char *label, float score, void *ctx)
{
    ARG_UNUSED(ctx);
    ARG_UNUSED(label);
    ARG_UNUSED(score);
}

static void log_stats(uint32_t n)
{
    if (n % LOG_INTERVAL != 0) return;
    LOG_INF("source ok=%u overruns=%u",
            rx_source.base.stats.blocks_ok,
            rx_source.base.stats.overruns);
    LOG_INF("delay  depth=%u dropped=%u",
            pcm_delay_node_stats(&delay_node)->queue_depth,
            pcm_delay_node_stats(&delay_node)->dropped);
    LOG_INF("sink   ok=%u dropped=%u restarts=%u",
            tx_sink.base.stats.blocks_ok,
            tx_sink.base.stats.dropped,
            tx_sink.base.stats.restarts);
    pcm_ml_node_log_stats(&ml_node);
}

int main(void)
{
    int err;

    pcm_stream_info_t fmt = {
        .sample_rate = SAMPLE_RATE,
        .channels    = NUM_CHANNELS,
        .format      = PCM_FMT_S16_LE,
        .frames      = FRAMES,
    };

    i2s_source_cfg_t src_cfg = {
        .dev               = DEVICE_DT_GET(DT_ALIAS(i2s_rx)),
        .slab              = &rx_slab,
        .stream            = fmt,
        .driver_timeout_ms = 1000,
    };
    err = i2s_source_init(&rx_source, &src_cfg);
    if (err < 0) { LOG_ERR("source init: %d", err); return err; }

    i2s_sink_cfg_t snk_cfg = {
        .dev               = DEVICE_DT_GET(DT_ALIAS(i2s_tx)),
        .slab              = &tx_slab,
        .stream            = fmt,
        .driver_timeout_ms = 2000,
        .prefill_blocks    = 3,
    };
    err = i2s_sink_init(&tx_sink, &snk_cfg);
    if (err < 0) { LOG_ERR("sink init: %d", err); return err; }

    /* ML node — pass static stack, no heap allocation */
    pcm_ml_node_cfg_t ml_cfg = {
        .input_channels = NUM_CHANNELS,
        .result_cb      = on_ml_result,
        .result_cb_ctx  = NULL,
        .infer_priority = 7,
    };
    err = pcm_ml_node_init(&ml_node, &ml_cfg, ml_infer_stack);
    if (err < 0) { LOG_ERR("ml_node init: %d", err); return err; }

    pcm_delay_node_cfg_t dly_cfg = {
        .delay_blocks = DELAY_BLOCKS,
        .max_blocks   = 0,
    };
    err = pcm_delay_node_init(&delay_node, &dly_cfg);
    if (err < 0) { LOG_ERR("delay init: %d", err); return err; }

    err = pcm_source_start((pcm_source_t *)&rx_source);
    if (err < 0) { LOG_ERR("source start: %d", err); return err; }

    LOG_INF("ML pipeline ready — listening for keywords");

    bool     tx_started  = false;
    uint32_t block_count = 0;

    while (1) {
        pcm_block_t raw = {0};
        err = pcm_source_read((pcm_source_t *)&rx_source, &raw, K_FOREVER);
        if (err < 0) { LOG_WRN("source read err %d", err); continue; }

        pcm_block_t stereo = {0};
        err = pcm_mono_to_stereo_s16(&raw, &stereo, AUDIO_GAIN);
        pcm_source_release((pcm_source_t *)&rx_source, &raw);
        if (err < 0) { LOG_WRN("convert err %d", err); continue; }

        /* ML tap — non-destructive */
        pcm_ml_node_process(&ml_node, &stereo);

        err = pcm_delay_node_push(&delay_node, &stereo);
        if (err < 0) { k_free(stereo.data); continue; }

        if (!tx_started && pcm_delay_node_is_primed(&delay_node)) {
            err = pcm_sink_start((pcm_sink_t *)&tx_sink);
            if (err < 0) { LOG_ERR("sink start: %d", err); return err; }
            tx_started = true;
            LOG_INF("TX started");
        }

        if (tx_started) {
            pcm_block_t delayed = {0};
            err = pcm_delay_node_pop(&delay_node, &delayed);
            if (err == -ENODATA) {
                pcm_sink_drain((pcm_sink_t *)&tx_sink);
                pcm_sink_start((pcm_sink_t *)&tx_sink);
                tx_started = false;
            } else if (err == 0) {
                err = pcm_sink_write((pcm_sink_t *)&tx_sink,
                                     &delayed, K_MSEC(500));
                if (err < 0) k_free(delayed.data);
            }
        }

        log_stats(++block_count);
    }

    return 0;
}
```
